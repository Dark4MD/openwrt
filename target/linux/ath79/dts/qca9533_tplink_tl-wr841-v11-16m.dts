// SPDX-License-Identifier: GPL-2.0-or-later OR MIT
/dts-v1/;

#include "qca9533_tplink_tl-wr841-v11-16m.dtsi"

/ {
	compatible = "tplink,tl-wr841-v11-16m", "qca,qca9533";
	model = "TP-Link TL-WR841N/ND Mod (16M) v11";
};
