// SPDX-License-Identifier: GPL-2.0-or-later OR MIT
/dts-v1/;

#include "qca9533_tplink_tl-wr841-16m.dtsi"

/ {
	compatible = "tplink,tl-wr841-v9-16m", "qca,qca9533";
	model = "TP-Link TL-WR841N/ND Mod (16M) v9";

	aliases {
		led-boot = &qss_led;
		led-failsafe = &qss_led;
		led-running = &qss_led;
		led-upgrade = &qss_led;
	};
};
